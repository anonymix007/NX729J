## drivers/nubia/Kconfig
```kconfig
#
# Nubia drivers configuration
#

#menuconfig NUBIA_DRIVERS
menu "nubia drivers"

config NUBIAFULLCONFIG
	tristate "NUBIA FULL CONFIG"
	default n
	help
	  Say Y here if you want to enable NUBIA FULL CONFIG
	  If unsure, say N.

comment "Nubia Full Config"

config NUBIA_PROJECT
	string "NUBIA PROJECT"
	default "nubia_baseline"
	help
	  Say Y here if you want to enable NUBIA PROJECT
	  If unsure, say N.

comment "Nubia Project"

config NUBIA_DRIVERS
	tristate "NUBIA DRIVERS"
	default n
	help
	  Say Y here if you want to enable NUBIA DRIVERS
	  If unsure, say N.

comment "Nubia Device Drivers"

config NUBIA_SENSORS_SENS
	bool "NUBIA_SENSORS_SENS"
	default n
	help
	  Say Y here if you have enable NUBIA_SENSORS_SENS
	  If unsure, say N.

comment "Nubiai Sensors Sensitive"

source "drivers/nubia/nubia_hw_version/Kconfig"
source "drivers/nubia/nubia_vendor_hook/Kconfig"
source "drivers/nubia/sensors_sensitivity/Kconfig"
source "drivers/nubia/goodix_berlin_driver/Kconfig"
source "drivers/nubia/fan/Kconfig"
source "drivers/nubia/samsung/Kconfig"
source "drivers/nubia/aw86927_double/Kconfig"

if NUBIA_DRIVERS
config NUBIA_FINGERPRINT
        tristate "NUBIA_FINGERPRINT"
        default n
        help
         Say Y here if you have enable NUBIA_FINGERPRINT
         IF  unsure ,say N
endif
if NUBIA_FINGERPRINT
source "drivers/nubia/fingerprint/Kconfig"
endif
source "drivers/nubia/aw96205/Kconfig"
source "drivers/nubia/nubia_gpio_keys/Kconfig"
#NUBIA LED START
source "drivers/nubia/nubia_led/Kconfig"
#NUBIA LED END

source "drivers/nubia/nblog/Kconfig"
source "drivers/nubia/nb_boost/Kconfig"
endmenu
```

## drivers/nubia/fan/Kconfig
```kconfig
#
# Fan driver configuration
#
menuconfig NUBIA_FAN
	bool "Fan"
	default n
	help
	  Say Y here if you have a Fan connected
	  to your system.

config SOC_FAN
        tristate "Soc Fan"
        default n
       help
          Say Y here if you use soc control fan.

#config FAN_UPDATA
#	bool "Fan updata"
#	default n
```

## drivers/nubia/nb_boost/Kconfig
```kconfig
#
# nubia task boost driver configuration
#

config NUBIA_BOOST_TASK
        tristate "Nubia boost task"
        default n
        help
          add nubia boost task
```

## drivers/nubia/nubia_gpio_keys/Kconfig
```kconfig
#
# nubia gpio keys driver configuration
#

config NUBIA_KEYBOARD_GAMESWITCH
        tristate "Keypad NUBIA GameSwitchkey"
        depends on KEYBOARD_GPIO
        default n
        help
          Addr GameSwitchkey attr
```

## drivers/nubia/nubia_led/Kconfig
```kconfig
#
# nubia led driver configuration
#

config NUBIG_HAPTIC_GKI
    bool "Haptic driver for awinic aw8697 for gki"
    default n
    help
      nubia aw8697 for GKI test.

menuconfig NUBIA_LED
	tristate "nubia led driver"
	default n
	help
	  Say Y here if you have a nubia led connected
	  to your system.

	  If unsure, say N.

if NUBIA_LED

source "drivers/nubia/nubia_led/aw22xxx/Kconfig"
endif
```

## drivers/nubia/nubia_vendor_hook/Kconfig
```kconfig
config NUBIA_VENDOR_HOOK
	tristate "NUBIA VENDOR HOOK"
        default n
	help
	  Enable nubia vendor all vendor hook.

config NUBIA_FREEZER
	tristate "NUBIA FREEZER"
        default n
	help
	  Enable nubia hook for freezer function.
```
